
#ifndef SENSOR_TEMP_HUMID_H
	#define SENSOR_TEMP_HUMID_H
#endif

#ifndef ADAFRUIT_SHT31_H
	#include "Adafruit_SHT31.h"
#endif

#ifndef TIME_FUNCS_H
    #include "../DateTime/time_funcs.h"
#endif

#ifndef GLOBALS_H
    #include "../globals.h"
#endif

#define SHT31_I2C_ADDR 0x44

#define NUM_MINS_IN_DAY 1440
#define TEMP_HUMID_ARR_SIZE NUM_MINS_IN_DAY

// ========================================= //
// For video making
float temperature_array[TEMP_HUMID_ARR_SIZE] = {22.16, 22.13, 22.13, 22.16, 22.17, 22.18, 22.18, 22.23, 22.23, 22.23, 22.2, 22.23, 22.21,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 22.12, 22.12};
float humidity_array[TEMP_HUMID_ARR_SIZE] = {39.17, 39.89, 40.04, 40.28, 40.57, 40.47, 40.58, 40.67, 40.67, 40.67, 40.74, 40.75, 40.69,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 39.12, 39.12};
// ========================================= //

// // These store 1 reading per minute
// float temperature_array[TEMP_HUMID_ARR_SIZE];
// float humidity_array[TEMP_HUMID_ARR_SIZE];

float min_temp = 1000;
float max_temp=-1000;

float min_humid = 1000;
float max_humid=-1000;

bool enableHeater = false;
uint8_t loopCnt = 0;

float read_temp(Adafruit_SHT31* sht31);
float read_humid(Adafruit_SHT31* sht31);
void temp_humid_manager(time_t TimeStamp, Adafruit_SHT31* sht31);
void print_temp_array();
void print_humid_array();
void init_temp_humid_sensor(Adafruit_SHT31* sht31);

// ---------------------------------------------------------------------------- //
float read_temp(Adafruit_SHT31* sht31){
	float t = sht31->readTemperature();
	return t;
}

float read_humid(Adafruit_SHT31* sht31){
	float h = sht31->readHumidity();
	return h;
}

// ---------------------------------------------------------------------------- //
void temp_humid_manager(time_t TimeStamp, Adafruit_SHT31* sht31)
/* Reads temp/humid values and assigns them to corresponding index 0 to 1399 */
{
	LOG_TRACE("");
	// Temp / humid read
	float h=read_humid(sht31);
	float t=read_temp(sht31);

	// Check for min & max vals
	if (t>max_temp)
		max_temp=t;
	if (t<min_temp)
		min_temp=t;

	if (h>max_humid)
		max_humid=h;
	if (h<min_humid)
		min_humid=h;

	uint16_t now_minute=get_minute_of_day(now()+TIME_ZONE_DIFF_SECS);

	temperature_array[now_minute-1]=t;
	humidity_array[now_minute-1]=h;

	// Serial.println("now_minute: "+String(now_minute)+" | T: "+String(t)+" | H: "+String(h));

}

// ---------------------------------------------------------------------------- //
void print_temp_array()
/* Print entire array */
{
	Serial.println("temperature_array: ");
	for (int i=0;i<TEMP_HUMID_ARR_SIZE;i++){
			Serial.print (String(temperature_array[i])+" ");
			if (i%19==0)
				Serial.println();
			// humidity_array[i]=0;
		}
		Serial.println();
}

void print_humid_array()
/* Print entire array */
{
	Serial.println("humidity_array_array: ");
	for (int i=0;i<TEMP_HUMID_ARR_SIZE;i++){
			Serial.print (String(humidity_array[i])+" ");
			if (i%19==0)
				Serial.println();
			// humidity_array[i]=0;
		}
}

// ---------------------------------------------------------------------------- //
void init_temp_humid_sensor(Adafruit_SHT31* sht31)
/* Initialize SHT31 sensor. Init temp & humid arrays
   for 1440 minutes (i.e. 1 per min of day) */
{
	// Temperature & humidity sensor
	sht31->begin(SHT31_I2C_ADDR);
	// for (int i=0;i<TEMP_HUMID_ARR_SIZE;i++){
	// 	temperature_array[i]=0;
	// 	humidity_array[i]=0;
	// }
}